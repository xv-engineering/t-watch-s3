## CMakeLists.txt
```
# Copyright (c) 2025, Noah Luskey <noah@vvvvvvvvvv.io>
# SPDX-License-Identifier: Apache-2.0

cmake_minimum_required(VERSION 3.20.0)
find_package(Zephyr REQUIRED)

project(bringup)
target_sources(app PRIVATE 
    src/main.c
    src/hello_world.c 
    src/power.c 
    src/haptics.c
    src/display.c
    src/touch.c
    src/imu.c
    src/rtc.c
    src/button.c
    src/charger.c
    src/fuel_gauge.c
    src/lora.c
    src/lorawan.c
    src/flash.c
    src/wifi.c
    src/bluetooth.c
)


# Needed for the 'zdsp_backend.h' dummy header file
target_include_directories(app PRIVATE src)
```

## Kconfig
```
# Copyright (c) 2025, Noah Luskey <noah@vvvvvvvvvv.io>
# SPDX-License-Identifier: Apache-2.0

config RUNNING_UNDER_CI
    bool "Running under CI"
    default n
    help
        Set this to y if the tests are running under CI. This will
        skip tests that require user interaction, as well as tests
        that would fail under CI (such as the charger test that
        expects the battery to be removed).


module = BRINGUP
module-str = bringup
source "subsys/logging/Kconfig.template.log_config"


source "Kconfig.zephyr"
```

## prj.conf
```kconfig
CONFIG_ZTEST=y
CONFIG_BRINGUP_LOG_LEVEL_DBG=y
CONFIG_LORAMAC_REGION_US915=y
CONFIG_BT_OBSERVER=y
```

## src/main.c
```c
#include <zephyr/logging/log.h>
LOG_MODULE_REGISTER(bringup, CONFIG_BRINGUP_LOG_LEVEL);
```

## src/bluetooth.c
```c
#include <zephyr/ztest.h>
#include <zephyr/bluetooth/bluetooth.h>
#include <zephyr/bluetooth/hci.h>

#include <zephyr/logging/log.h>
LOG_MODULE_DECLARE(bringup, CONFIG_BRINGUP_LOG_LEVEL);

BUILD_ASSERT(IS_ENABLED(CONFIG_BT_OBSERVER));

struct bluetooth_fixture
{
    atomic_t bt_enabled;
    struct k_sem scan_sem;
};

// annoyingly, can't figure out how to retrieve the fixture
// from the scan or ready callback. Seems that it must be global.
static struct bluetooth_fixture bt_fixture = {
    // doesn't need to be as large as the total number
    // of advertisements we expect, but good to have
    // it be a bit larger so there's some buffer.
    .scan_sem = Z_SEM_INITIALIZER(bt_fixture.scan_sem, 0, 5),
    .bt_enabled = ATOMIC_INIT(0),
};

static void bt_ready_cb(int err)
{
    atomic_set(&bt_fixture.bt_enabled, (err == 0));
}

static void scan_cb(const bt_addr_le_t *addr, int8_t rssi, uint8_t adv_type,
                    struct net_buf_simple *ad)
{
    char addr_str[BT_ADDR_LE_STR_LEN] = {0};
    size_t addr_len = bt_addr_le_to_str(addr, addr_str, sizeof(addr_str));
    LOG_INF("Device found: %.*s (RSSI %d), adv_type: %u", addr_len, addr_str, rssi, adv_type);

    if (ad)
    {
        LOG_INF("Advertisement data length: %u", ad->len);
    }

    k_sem_give(&bt_fixture.scan_sem);
}

// Test that initializes Bluetooth and scans for advertisements
ZTEST_F(bluetooth, test_scan)
{
    struct bluetooth_fixture *f = fixture;
    static struct bt_le_scan_param scan_params = {
        .type = BT_LE_SCAN_TYPE_ACTIVE,
        .options = BT_LE_SCAN_OPT_NONE,
        .interval = BT_GAP_SCAN_FAST_INTERVAL,
        .window = BT_GAP_SCAN_FAST_WINDOW,
    };

    // the setup should've initialized bluetooth and waited for
    // it to be ready.
    zassert_true(f->bt_enabled, "Bluetooth failed to initialize");

    // start scanning
    int ret = bt_le_scan_start(&scan_params, scan_cb);
    zassert_equal(ret, 0, "Scanning failed to start (err %d)", ret);
    LOG_INF("Scanning started successfully");

    // wait for 5 advertisements withing 5 seconds
    int count = 0;
    k_timepoint_t end = sys_timepoint_calc(K_SECONDS(5));
    k_timeout_t timeout;
    do
    {
        timeout = sys_timepoint_timeout(end);
        ret = k_sem_take(&f->scan_sem, timeout);
        zassert_equal(ret, 0, "Scan timeout reached (%d ms)", 5000);
        count++;
    } while (!K_TIMEOUT_EQ(timeout, K_NO_WAIT) && count < 5);
    zassert_equal(count, 5);

    // stop scanning
    ret = bt_le_scan_stop();
    zassert_equal(ret, 0, "Scanning failed to stop (err %d)", ret);
    LOG_INF("Scanning stopped");
}

static void *bluetooth_tests_setup(void)
{
    // There is a bug in the esp32 bluetooth driver that asserts on enable
    // after the driver is disabled. Ideally, in the teardown, we'd do a
    // bt_disable, but we can't for now. And since we also shouldn't do
    // a double-enable, we only do an enable if the bt_fixture says that
    // we haven't been enabled yet.
    //
    // (BLE assert intc.c 222, param 00000008 ffffffed)
    if (!atomic_get(&bt_fixture.bt_enabled))
    {
        bt_enable(bt_ready_cb);
        WAIT_FOR(atomic_get(&bt_fixture.bt_enabled), 1000000, k_yield());
    }
    return &bt_fixture;
}

static void bluetooth_tests_before(void *fixture)
{
    struct bluetooth_fixture *f = fixture;
    atomic_set(&f->bt_enabled, bt_is_ready());
    k_sem_reset(&f->scan_sem);
}

ZTEST_SUITE(bluetooth, NULL, bluetooth_tests_setup, bluetooth_tests_before, NULL, NULL);
```

## src/button.c
```c
#include <zephyr/ztest.h>
#include <zephyr/input/input.h>
#include <zephyr/drivers/gpio.h>

#include <zephyr/logging/log.h>
LOG_MODULE_DECLARE(bringup, CONFIG_BRINGUP_LOG_LEVEL);

struct button_fixture
{
    struct k_sem external_press_sem;
    struct k_sem external_release_sem;
    struct k_sem internal_press_sem;
    struct k_sem internal_release_sem;
    struct k_sem unexpected_sem;
};

static void button_callback(struct input_event *evt, void *user_data)
{
    struct button_fixture *f = user_data;
    if (evt->dev == DEVICE_DT_GET(DT_ALIAS(buttons)))
    {
        if (evt->code == INPUT_BTN_SIDE)
        {
            if (evt->value == 1)
            {
                k_sem_give(&f->external_press_sem);
            }
            else
            {
                k_sem_give(&f->external_release_sem);
            }
        }
        else if (evt->code == INPUT_BTN_EXTRA)
        {
            if (evt->value == 1)
            {
                k_sem_give(&f->internal_press_sem);
            }
            else
            {
                k_sem_give(&f->internal_release_sem);
            }
        }
    }
}

ZTEST_F(button, test_power_button)
{
    if (IS_ENABLED(CONFIG_RUNNING_UNDER_CI))
    {
        ztest_test_skip();
    }
    struct button_fixture *f = fixture;
    int ret;
    LOG_PRINTK("Short-Press the external button twice\n");
    ret = k_sem_take(&f->external_press_sem, K_SECONDS(3));
    zassert_equal(ret, 0);
    LOG_PRINTK("External button pressed\n");
    ret = k_sem_take(&f->external_release_sem, K_SECONDS(3));
    zassert_equal(ret, 0);
    LOG_PRINTK("External button released\n");
    ret = k_sem_take(&f->external_press_sem, K_SECONDS(3));
    zassert_equal(ret, 0);
    LOG_PRINTK("External button pressed again\n");
    ret = k_sem_take(&f->external_release_sem, K_SECONDS(3));
    zassert_equal(ret, 0);
    LOG_PRINTK("External button released again\n");

    zassert_equal(k_sem_count_get(&f->unexpected_sem), 0, "Unexpected button event");
}

ZTEST_F(button, test_internal_button)
{
    if (IS_ENABLED(CONFIG_RUNNING_UNDER_CI))
    {
        ztest_test_skip();
    }
    struct button_fixture *f = fixture;
    int ret;
    LOG_PRINTK("Press the internal button twice\n");
    ret = k_sem_take(&f->internal_press_sem, K_SECONDS(3));
    zassert_equal(ret, 0); // a timeout indicates button wasn't pressed in time
    LOG_PRINTK("Internal button pressed\n");
    ret = k_sem_take(&f->internal_release_sem, K_SECONDS(3));
    zassert_equal(ret, 0);
    LOG_PRINTK("Internal button released\n");
    ret = k_sem_take(&f->internal_press_sem, K_SECONDS(3));
    zassert_equal(ret, 0);
    LOG_PRINTK("Internal button pressed again\n");
    ret = k_sem_take(&f->internal_release_sem, K_SECONDS(3));
    zassert_equal(ret, 0);
    LOG_PRINTK("Internal button released again\n");

    zassert_equal(k_sem_count_get(&f->unexpected_sem), 0, "Unexpected button event");
    ztest_test_pass();
}

static void *button_tests_setup(void)
{
    static struct button_fixture fixture = {
        .external_press_sem = Z_SEM_INITIALIZER(fixture.external_press_sem, 0, 2),
        .external_release_sem = Z_SEM_INITIALIZER(fixture.external_release_sem, 0, 2),
        .internal_press_sem = Z_SEM_INITIALIZER(fixture.internal_press_sem, 0, 2),
        .internal_release_sem = Z_SEM_INITIALIZER(fixture.internal_release_sem, 0, 2),
        .unexpected_sem = Z_SEM_INITIALIZER(fixture.unexpected_sem, 0, 1),
    };

    INPUT_CALLBACK_DEFINE(DEVICE_DT_GET(DT_ALIAS(buttons)), button_callback, &fixture);
    return &fixture;
}

static void button_tests_before(void *fixture)
{
    struct button_fixture *f = fixture;
    k_sem_reset(&f->external_press_sem);
    k_sem_reset(&f->external_release_sem);
    k_sem_reset(&f->internal_press_sem);
    k_sem_reset(&f->internal_release_sem);
    k_sem_reset(&f->unexpected_sem);
}

ZTEST_SUITE(button, NULL, button_tests_setup, button_tests_before, NULL, NULL);
```

## src/charger.c
```c
#include <zephyr/ztest.h>
#include <zephyr/drivers/charger.h>

#include <zephyr/logging/log.h>
LOG_MODULE_REGISTER(charger, CONFIG_BRINGUP_LOG_LEVEL);

// For this test to pass, the battery switch inside must
// be switched to the disconnected position (or battery removed entirely)
ZTEST(charger, test_charger_disconnected)
{
    if (IS_ENABLED(CONFIG_RUNNING_UNDER_CI))
    {
        // Not exactly an interactive test, but for the device
        // to be in this state, it must be unplugged from a power
        // source, which means it's probably not under CI
        ztest_test_skip();
    }

    LOG_WRN("This test assumes the battery is disconnected");
    const struct device *dev = DEVICE_DT_GET(DT_ALIAS(charger));
    zassert_true(device_is_ready(dev), "charger device not ready");

    // the charger supports reporting of "ONLINE" (meaning plugged in)
    union charger_propval val;
    int ret = charger_get_prop(dev, CHARGER_PROP_ONLINE, &val);
    zassert_equal(ret, 0);
    zassert_equal(val.online, CHARGER_ONLINE_FIXED);

    ret = charger_get_prop(dev, CHARGER_PROP_PRESENT, &val);
    zassert_equal(ret, 0);
    zassert_false(val.present);

    ret = charger_get_prop(dev, CHARGER_PROP_STATUS, &val);
    zassert_equal(ret, 0);
    zassert_equal(val.status, CHARGER_STATUS_NOT_CHARGING);
}

// For this test to pass, the battery switch inside must
// be switched to the connected position (and a battery connected)
ZTEST(charger, test_charger_connected)
{
    LOG_WRN("This test assumes the battery is connected");
    const struct device *dev = DEVICE_DT_GET(DT_ALIAS(charger));
    zassert_true(device_is_ready(dev), "charger device not ready");

    union charger_propval val;
    int ret = charger_get_prop(dev, CHARGER_PROP_ONLINE, &val);
    zassert_equal(ret, 0);
    zassert_true(val.online);

    ret = charger_get_prop(dev, CHARGER_PROP_PRESENT, &val);
    zassert_equal(ret, 0);
    zassert_true(val.present);

    // it's either charging or in standby, depends how long
    // things have been plugged in, but it's definitely
    // not discharging since we're plugged in to a supply.
    ret = charger_get_prop(dev, CHARGER_PROP_STATUS, &val);
    zassert_equal(ret, 0);
    zassert_not_equal(val.status, CHARGER_STATUS_DISCHARGING);
}

ZTEST_SUITE(charger, NULL, NULL, NULL, NULL, NULL);
```

## src/display.c
```c
#include <zephyr/ztest.h>
#include <zephyr/drivers/regulator.h>
#include <zephyr/drivers/pwm.h>
#include <zephyr/drivers/display.h>

BUILD_ASSERT(IS_ENABLED(CONFIG_PWM), "PWM is not enabled");
BUILD_ASSERT(IS_ENABLED(CONFIG_REGULATOR), "Regulator is not enabled");

#include <zephyr/logging/log.h>
LOG_MODULE_DECLARE(bringup, CONFIG_BRINGUP_LOG_LEVEL);

ZTEST(display, test_backlight)
{
    const struct device *lcd_vdd = DEVICE_DT_GET(DT_NODELABEL(lcd_vdd));
    zassert_not_null(lcd_vdd, "Failed to get lcd_vdd device");
    zassert_true(device_is_ready(lcd_vdd), "lcd_vdd device is not ready");
    zassert_true(regulator_is_enabled(lcd_vdd), "lcd_vdd is not enabled");

    const struct pwm_dt_spec backlight = PWM_DT_SPEC_GET(DT_ALIAS(backlight));

    // cycle from dimmest to brightest
    for (int i = 0; i < 100; i++)
    {
        LOG_INF("Setting backlight to %d%%", i);
        int ret = pwm_set_pulse_dt(&backlight, PWM_USEC(i));
        zassert_equal(ret, 0, "Failed to set backlight");
        k_sleep(K_MSEC(1));
    }

    for (int i = 100; i >= 0; i--)
    {
        LOG_INF("Setting backlight to %d%%", i);
        int ret = pwm_set_pulse_dt(&backlight, PWM_USEC(i));
        zassert_equal(ret, 0, "Failed to set backlight");
        k_sleep(K_MSEC(1));
    }

    // flash the display to make sure extremes work
    for (int i = 0; i < 10; i++)
    {
        LOG_INF("Flashing display");
        int ret = pwm_set_pulse_dt(&backlight, PWM_USEC(0));
        zassert_equal(ret, 0, "Failed to set backlight");
        k_sleep(K_MSEC(20));
        ret = pwm_set_pulse_dt(&backlight, PWM_USEC(100));
        zassert_equal(ret, 0, "Failed to set backlight");
        k_sleep(K_MSEC(20));
    }

    ztest_test_pass();
}

ZTEST(display, test_capabilities)
{
    const struct device *display = DEVICE_DT_GET(DT_CHOSEN(zephyr_display));
    zassert_true(device_is_ready(display));

    struct display_capabilities capabilities;
    display_get_capabilities(display, &capabilities);
    zassert_equal(capabilities.x_resolution, 240);
    zassert_equal(capabilities.y_resolution, 240);
    zassert_equal(capabilities.current_pixel_format, PIXEL_FORMAT_BGR_565);

    // The orientation reported by the driver is wrong, but it doesn't matter.
    // The orientation is directly set by the mdac settings in the devicetree.

    ztest_test_pass();
}

ZTEST(display, test_colors)
{
    const struct device *display = DEVICE_DT_GET(DT_CHOSEN(zephyr_display));
    zassert_true(device_is_ready(display), "Display not ready");

    // Turn on display
    int ret = display_blanking_off(display);
    zassert_equal(ret, 0, "Failed to turn on display");

    // full background in small chunks
    const size_t rect_w = 60;
    const size_t rect_h = 20;
    const size_t buf_size = rect_w * rect_h * 2; // 2 bytes per pixel for RGB565
    uint8_t *buf = k_malloc(buf_size);
    zassert_not_null(buf, "Failed to allocate buffer");

    struct display_buffer_descriptor buf_desc = {
        .buf_size = buf_size,
        .width = rect_w,
        .height = rect_h,
        .pitch = rect_w};

    memset(buf, 0x00, buf_size);

    // full background, black, in small chunks
    BUILD_ASSERT(240 % rect_h == 0, "240 is not divisible by rect_h");
    BUILD_ASSERT(240 % rect_w == 0, "240 is not divisible by rect_w");
    for (size_t y = 0; y < 240; y += rect_h)
    {
        for (size_t x = 0; x < 240; x += rect_w)
        {
            ret = display_write(display, x, y, &buf_desc, buf);
            zassert_equal(ret, 0, "Failed to write full background");
        }
    }

    ret = display_blanking_off(display);
    zassert_equal(ret, 0, "Failed to disable blanking");

    // Draw red rectangle in top left
    for (size_t i = 0; i < buf_size; i += 2)
    {
        buf[i] = 0xF8;     // Red: 11111000
        buf[i + 1] = 0x00; // 00000000
    }
    ret = display_write(display, 0, 0, &buf_desc, buf);
    zassert_equal(ret, 0, "Failed to write red rectangle");

    // Draw green rectangle in top right
    for (size_t i = 0; i < buf_size; i += 2)
    {
        buf[i] = 0x07;     // Green: 00000111
        buf[i + 1] = 0xE0; // 11100000
    }
    ret = display_write(display, 240 - rect_w, 0, &buf_desc, buf);
    zassert_equal(ret, 0, "Failed to write green rectangle");

    // Draw blue rectangle in bottom right
    for (size_t i = 0; i < buf_size; i += 2)
    {
        buf[i] = 0x00;     // Blue: 00000000
        buf[i + 1] = 0x1F; // 00011111
    }
    ret = display_write(display, 240 - rect_w, 240 - rect_h, &buf_desc, buf);
    zassert_equal(ret, 0, "Failed to write blue rectangle");

    // Draw white rectangle in bottom left
    for (size_t i = 0; i < buf_size; i += 2)
    {
        buf[i] = 0xFF;     // White: 11111111
        buf[i + 1] = 0xFF; // 11111111
    }
    ret = display_write(display, 0, 240 - rect_h, &buf_desc, buf);
    zassert_equal(ret, 0, "Failed to write white rectangle");

    k_free(buf);
    ztest_test_pass();
}

ZTEST_SUITE(display, NULL, NULL, NULL, NULL, NULL);
```

## src/flash.c
```c
#include <zephyr/ztest.h>
#include <zephyr/drivers/flash.h>
#include <zephyr/storage/flash_map.h>

#include <zephyr/logging/log.h>
LOG_MODULE_DECLARE(bringup, CONFIG_BRINGUP_LOG_LEVEL);

// in any normal app, you'd probably want to use one of the many
// available filesystems (tinyfs, ZMS, etc.) to actually deal
// with the flash memory.
ZTEST(flash, test_flash_rw)
{
    const struct device *flash = DEVICE_DT_GET(DT_CHOSEN(zephyr_flash_controller));
    zassert_true(device_is_ready(flash), "flash device not ready");

    const off_t address = FIXED_PARTITION_OFFSET(storage_partition);
    const char data[] = "Hello, World!";

    const struct flash_parameters *parameters = flash_get_parameters(flash);
    zassert_not_null(parameters, "flash parameters not found");
    // annoyingly, the flash parameters does not contain the erase block
    // size. We have to get it from the flash node instead.
    const size_t erase_size = DT_PROP(DT_CHOSEN(zephyr_flash), erase_block_size);

    int ret = flash_erase(flash, address, erase_size);
    zassert_equal(ret, 0);

    ret = flash_write(flash, address, data, sizeof(data));
    zassert_equal(ret, 0);

    // read it back
    char buffer[sizeof(data)];
    ret = flash_read(flash, address, buffer, sizeof(data));
    zassert_equal(ret, 0);
    zassert_mem_equal(buffer, data, sizeof(data));

    // erase it and make sure the read now returns empty data
    ret = flash_erase(flash, address, erase_size);
    zassert_equal(ret, 0);
    ret = flash_read(flash, address, buffer, sizeof(data));
    zassert_equal(ret, 0);

    char expected[sizeof(data)];
    memset(expected, parameters->erase_value, sizeof(expected));
    zassert_mem_equal(buffer, expected, sizeof(data));
}

ZTEST(flash, test_flash_fill)
{
    const struct device *flash = DEVICE_DT_GET(DT_CHOSEN(zephyr_flash_controller));
    zassert_true(device_is_ready(flash), "flash device not ready");

    const struct flash_parameters *parameters = flash_get_parameters(flash);
    zassert_not_null(parameters, "flash parameters not found");

    const off_t address = FIXED_PARTITION_OFFSET(storage_partition);
    const size_t size = FIXED_PARTITION_SIZE(storage_partition);

    int ret = flash_erase(flash, address, size);
    zassert_equal(ret, 0);

    ret = flash_fill(flash, 0xA5, address, size);
    zassert_equal(ret, 0);

    char buffer[32];
    char expected[sizeof(buffer)];
    memset(expected, 0xA5, sizeof(expected));
    BUILD_ASSERT(size % sizeof(buffer) == 0, "size must be a multiple of buffer size");
    for (off_t pos = address; pos < address + size; pos += sizeof(buffer))
    {
        ret = flash_read(flash, pos, buffer, sizeof(buffer));
        zassert_equal(ret, 0);
        zassert_mem_equal(buffer, expected, sizeof(buffer));
    }

    ret = flash_erase(flash, address, size);
    zassert_equal(ret, 0);
    memset(expected, parameters->erase_value, sizeof(expected));

    for (off_t pos = address; pos < address + size; pos += sizeof(buffer))
    {
        ret = flash_read(flash, pos, buffer, sizeof(buffer));
        zassert_equal(ret, 0);
        zassert_mem_equal(buffer, expected, sizeof(buffer));
    }
}

ZTEST_SUITE(flash, NULL, NULL, NULL, NULL, NULL);
```

## src/fuel_gauge.c
```c
#include <zephyr/ztest.h>
#include <zephyr/drivers/fuel_gauge.h>
#include <zephyr/logging/log.h>
LOG_MODULE_DECLARE(bringup, CONFIG_BRINGUP_LOG_LEVEL);

ZTEST(fuel_gauge, test_fuel_gauge)
{
    LOG_PRINTK("This test assumes the battery is connected and not completely dead\n");
    const struct device *fuel = DEVICE_DT_GET(DT_NODELABEL(fuel_gauge));
    zassert_true(device_is_ready(fuel), "Fuel gauge device not ready");

    union fuel_gauge_prop_val val;
    int ret = fuel_gauge_get_prop(fuel, FUEL_GAUGE_VOLTAGE, &val);
    zassert_equal(ret, 0, "Failed to get voltage");
    LOG_INF("voltage: %d.%03d volts", val.voltage / 1000000, (val.voltage % 1000000) / 1000);
    zassert_between_inclusive(val.voltage, 3000000, 4200000);

    ret = fuel_gauge_get_prop(fuel, FUEL_GAUGE_ABSOLUTE_STATE_OF_CHARGE, &val);
    zassert_equal(ret, 0, "Failed to get absolute state of charge");
    LOG_INF("absolute state of charge: %d%%", val.absolute_state_of_charge);
    zassert_between_inclusive(val.absolute_state_of_charge, 0, 100);
}

ZTEST_SUITE(fuel_gauge, NULL, NULL, NULL, NULL, NULL);
```

## src/haptics.c
```c
#include <zephyr/ztest.h>
#include <zephyr/drivers/regulator.h>
#include <zephyr/drivers/haptics.h>
#include <zephyr/drivers/haptics/drv2605.h>

ZTEST(haptics, test_haptics)
{
    // LDO5 (Really BLDO2 - bad name from datasheet) must be enabled
    const struct device *ldo5 = DEVICE_DT_GET(DT_NODELABEL(ldo5));
    zassert_true(device_is_ready(ldo5), "LDO5 device is not ready");
    zassert_true(regulator_is_enabled(ldo5), "LDO5 is not enabled");

    const struct device *haptic = DEVICE_DT_GET(DT_ALIAS(haptic));
    zassert_true(device_is_ready(haptic), "Haptic device is not ready");

    // Play 4 strong clicks, each separated by
    // a 330 millisecond pause.
    static struct drv2605_rom_data rom_data = {
        .library = DRV2605_LIBRARY_TS2200_D,
        .brake_time = 0,
        .overdrive_time = 0,
        .sustain_neg_time = 0,
        .sustain_pos_time = 0,
        .trigger = DRV2605_MODE_INTERNAL_TRIGGER,
        .seq_regs[0] = 4,
        .seq_regs[1] = 33 | 0x80,
        .seq_regs[2] = 4,
        .seq_regs[3] = 33 | 0x80,
        .seq_regs[4] = 4,
        .seq_regs[5] = 33 | 0x80,
        .seq_regs[6] = 4,
    };

    union drv2605_config_data config = {
        .rom_data = &rom_data,
    };

    // Configure the haptic device
    int ret = drv2605_haptic_config(haptic, DRV2605_HAPTICS_SOURCE_ROM, &config);
    zassert_true(ret == 0, "Failed to configure haptic device");

    // Start haptic output
    ret = haptics_start_output(haptic);
    zassert_true(ret == 0, "Failed to start haptic output");

    // Wait for effect to complete (rough estimate)
    k_sleep(K_MSEC(1200));

    // Stop haptic output
    ret = haptics_stop_output(haptic);
    zassert_true(ret == 0, "Failed to stop haptic output");

    ztest_test_pass();
}

ZTEST_SUITE(haptics, NULL, NULL, NULL, NULL, NULL);
```

## src/hello_world.c
```c
#include <zephyr/ztest.h>

ZTEST(hello_world, test_hello_world)
{
    // Placeholder for now
    printk("Hello, world!\n");
    ztest_test_pass();
}

ZTEST_SUITE(hello_world, NULL, NULL, NULL, NULL, NULL);
```

## src/imu.c
```c
#include <zephyr/ztest.h>
#include <zephyr/drivers/sensor.h>
#include <zephyr/rtio/rtio.h>
#include <zephyr/dsp/utils.h>

#include <zephyr/logging/log.h>
LOG_MODULE_DECLARE(bringup, CONFIG_BRINGUP_LOG_LEVEL);

// Define RTIO context with a small pool for our one-shot reads
RTIO_DEFINE_WITH_MEMPOOL(imu_rtio, 1, 1, 1, 16, sizeof(void *));
SENSOR_DT_READ_IODEV(imu_iodev, DT_ALIAS(accel),
                     {SENSOR_CHAN_ACCEL_XYZ, 0});

ZTEST(imu, test_imu)
{
    LOG_PRINTK("This test assumes the watch is laying screen-up on a flat surface\n");
    const struct device *imu = DEVICE_DT_GET(DT_ALIAS(accel));
    zassert_true(device_is_ready(imu), "IMU device is not ready");

    int res = sensor_read_async_mempool(&imu_iodev, &imu_rtio, (void *)imu);
    zassert_equal(res, 0, "Sensor read failed");

    struct rtio_cqe *cqe = rtio_cqe_consume_block(&imu_rtio);
    zassert_not_null(cqe, "No completion event");
    zassert_equal(cqe->result, 0, "Sensor read failed");

    uint8_t *buf = NULL;
    uint32_t buf_len = 0;
    res = rtio_cqe_get_mempool_buffer(&imu_rtio, cqe, &buf, &buf_len);
    zassert_equal(res, 0, "Failed to get mempool buffer");
    zassert_not_null(buf, "Buffer is null");
    zassert_not_equal(buf_len, 0, "Buffer length is 0");
    // sanity check - we don't really need the user data
    // since we only have a single device in the io queue
    struct device *sensor = cqe->userdata;
    zassert_equal(sensor, imu, "Sensor mismatch");

    // done with the completion event, this does not release the buffer
    rtio_cqe_release(&imu_rtio, cqe);

    const struct sensor_decoder_api *decoder;
    res = sensor_get_decoder(sensor, &decoder);
    zassert_equal(res, 0, "Failed to get decoder");

    struct sensor_three_axis_data accel_data;
    uint32_t fit = 0;
    const struct sensor_chan_spec ch_spec = {.chan_idx = 0, .chan_type = SENSOR_CHAN_ACCEL_XYZ};
    res = decoder->decode(buf, ch_spec, &fit, 1, &accel_data);
    rtio_release_buffer(&imu_rtio, buf, buf_len);
    zassert_equal(fit, 1, "Fit is not 1");
    zassert_equal(res, 1, "Decode failed");

    LOG_INF("Accel data: %" PRIsensor_three_axis_data "\n", PRIsensor_three_axis_data_arg(accel_data, 0));

    double x = Z_SHIFT_Q31_TO_F32(accel_data.readings[0].x, accel_data.shift);
    double y = Z_SHIFT_Q31_TO_F32(accel_data.readings[0].y, accel_data.shift);
    double z = Z_SHIFT_Q31_TO_F32(accel_data.readings[0].z, accel_data.shift);

    // nominally 0
    zassert_between_inclusive(x, -1, 1, "X acceleration is too high");

    // nominally 0
    zassert_between_inclusive(y, -1, 1, "Y acceleration is too high");

    // nominally -9.81
    zassert_between_inclusive(z, -10.81, -8.81, "Z acceleration is too high");
}

ZTEST_SUITE(imu, NULL, NULL, NULL, NULL, NULL);
```

## src/lora.c
```c
#include <zephyr/ztest.h>
#include <zephyr/kernel.h>
#include <zephyr/drivers/lora.h>

#include <zephyr/logging/log.h>
LOG_MODULE_REGISTER(lora, CONFIG_BRINGUP_LOG_LEVEL);

static const struct lora_modem_config lora_base_config = {
    .frequency = 915000000,
    .bandwidth = BW_125_KHZ,
    .datarate = SF_10,
    .coding_rate = CR_4_8,
    .preamble_len = 12,
    .iq_inverted = false,
    .tx = false,
};

ZTEST(lora, test_lora_send)
{
    const struct device *lora = DEVICE_DT_GET(DT_ALIAS(lora));
    zassert_true(device_is_ready(lora), "Lora device not ready");
    struct lora_modem_config config = lora_base_config;
    config.tx_power = 20;
    config.tx = true;

    int ret = lora_config(lora, &config);
    zassert_equal(ret, 0, "Lora config failed (%d)", ret);

    uint8_t data[] = {'H', 'e', 'l', 'l', 'o', ',', ' ', 'W', 'o', 'r', 'l', 'd', '!'};
    ret = lora_send(lora, data, sizeof(data));
    zassert_equal(ret, 0, "Lora send failed (%d)", ret);
}

ZTEST(lora, test_lora_receive)
{
    if (IS_ENABLED(CONFIG_RUNNING_UNDER_CI))
    {
        ztest_test_skip();
    }

    LOG_PRINTK("This test expects test_lora_send to be run on another device\n");
    const struct device *lora = DEVICE_DT_GET(DT_ALIAS(lora));
    zassert_true(device_is_ready(lora), "Lora device not ready");
    struct lora_modem_config config = lora_base_config;

    int ret = lora_config(lora, &config);
    zassert_equal(ret, 0, "Lora config failed (%d)", ret);

    uint8_t data[20];
    int16_t rssi;
    int8_t snr;
    LOG_PRINTK("Waiting for data...\n");
    const char *expected_data = "Hello, World!";
    ret = lora_recv(lora, data, sizeof(data), K_SECONDS(10), &rssi, &snr);
    zassert_equal(ret, strlen(expected_data), "Lora recv failed (%d)", ret);

    LOG_INF("Received data: %.*s", ret, data);
    LOG_INF("RSSI: %d, SNR: %d", rssi, snr);

    zassert_mem_equal(data, expected_data, strlen(expected_data));
}

ZTEST_SUITE(lora, NULL, NULL, NULL, NULL, NULL);
```

## src/lorawan.c
```c
#include <zephyr/ztest.h>
#include <zephyr/lorawan/lorawan.h>

#include <zephyr/logging/log.h>
LOG_MODULE_DECLARE(bringup, CONFIG_BRINGUP_LOG_LEVEL);

static uint8_t dev_eui[] = {0xDD, 0xEE, 0xAA, 0xDD, 0xBB, 0xEE, 0xEE, 0xFF};
static uint8_t join_eui[] = {0x00, 0x00, 0x00, 0x00, 0x00, 0x00, 0x00, 0x00};
static uint8_t app_key[] = {0x2B, 0x7E, 0x15, 0x16, 0x28, 0xAE, 0xD2, 0xA6, 0xAB, 0xF7, 0x15, 0x88, 0x09, 0xCF, 0x4F, 0x3C};

static struct lorawan_join_config join_cfg = {
    .dev_eui = &dev_eui[0],
    .mode = LORAWAN_ACT_OTAA,
    .otaa = {
        .app_key = &app_key[0],
        .join_eui = &join_eui[0],
        .nwk_key = &app_key[0],
        // you may need to manually increase this or reset
        // the join counter within your network console.
        .dev_nonce = 2000,
    },
};

ZTEST(lorawan, test_lorawan_init)
{
    if (IS_ENABLED(CONFIG_RUNNING_UNDER_CI))
    {
        // This test isn't exactly interactive, but it does require
        // a connection to a network, which I don't want to hardcode.
        // So for now, this will just be skipped.
        ztest_test_skip();
    }

    // The device doesn't actually need to be named lora
    // under the aliases node. It is automatically used by the
    // loramac library simply by existing (via the `Radio` symbol)
    const struct device *lora = DEVICE_DT_GET(DT_ALIAS(lora));
    zassert_true(device_is_ready(lora), "Lora device not ready");

    int ret = lorawan_start();
    zassert_equal(ret, 0, "Lora start failed (%d)", ret);

    ret = lorawan_join(&join_cfg);
    // the first join always(?) fails. Unclear if this is a bug, the RP doc
    // seems to suggest that you should try again, and internally the loramac
    // node library will shift to a different channel.
    if (ret < 0)
    {
        LOG_ERR("lorawan_join_network failed, trying again: %d", ret);
        // the second join seems to (almost) always succeed
        join_cfg.otaa.dev_nonce++;
        ret = lorawan_join(&join_cfg);
        zassert_equal(ret, 0, "Lora join failed (%d)", ret);
    }

    uint8_t payload[] = "Hello";
    ret = lorawan_send(0, payload, sizeof(payload), LORAWAN_MSG_CONFIRMED);
    zassert_equal(ret, 0, "Lora send failed (%d)", ret);
}

ZTEST_SUITE(lorawan, NULL, NULL, NULL, NULL, NULL);
```

## src/power.c
```c
#include <zephyr/ztest.h>
#include <zephyr/drivers/regulator.h>

ZTEST(power, test_power)
{
    const struct device *lcd_vdd = DEVICE_DT_GET(DT_NODELABEL(lcd_vdd));
    zassert_not_null(lcd_vdd, "Failed to get lcd_vdd device");
    zassert_true(device_is_ready(lcd_vdd), "lcd_vdd device is not ready");
    zassert_true(regulator_is_enabled(lcd_vdd), "lcd_vdd is not enabled");

    const struct device *ldo5 = DEVICE_DT_GET(DT_NODELABEL(ldo5));
    zassert_not_null(ldo5, "Failed to get ldo5 device");
    zassert_true(device_is_ready(ldo5), "ldo5 device is not ready");
    zassert_true(regulator_is_enabled(ldo5), "ldo5 is not enabled");

    ztest_test_pass();
}

ZTEST_SUITE(power, NULL, NULL, NULL, NULL, NULL);
```
