## boards/t_watch_s3/Kconfig
```kconfig
# Copyright (c) 2025 Noah Luskey (noah@vvvvvvvvv.io)
# SPDX-License-Identifier: Apache-2.0

config HEAP_MEM_POOL_ADD_SIZE_BOARD
	int
	default 4096 if BOARD_T_WATCH_S3_ESP32S3_PROCPU
	default 256 if BOARD_T_WATCH_S3_ESP32S3_APPCPU

config LV_COLOR_16_SWAP
	bool
	depends on LVGL
	default y

config SHELL_STACK_SIZE
	int
	default 4096 if SHELL
```

## boards/t_watch_s3/Kconfig.t_watch_s3
```kconfig
# Copyright (c) 2024 Espressif Systems (Shanghai) Co., Ltd.
# SPDX-License-Identifier: Apache-2.0

config BOARD_T_WATCH_S3
	select SOC_ESP32S3_R8
	select SOC_ESP32S3_PROCPU if BOARD_T_WATCH_S3_ESP32S3_PROCPU
	select SOC_ESP32S3_APPCPU if BOARD_T_WATCH_S3_ESP32S3_APPCPU

config T_WATCH_S3_BACKLIGHT_BOOT_ON
	bool "Enable backlight on boot"
	default y
	help
		Enable backlight on boot.

module = T_WATCH_S3
module-str = t_watch_s3
source "subsys/logging/Kconfig.template.log_config"
```

## boards/t_watch_s3/board.yml
```yaml
board:
  name: t_watch_s3
  full_name: T-Watch S3
  vendor: vvvvvvvvvv llc
  socs:
  - name: esp32s3
```

## boards/t_watch_s3/t_watch_s3_procpu_defconfig
```kconfig
# SPDX-License-Identifier: Apache-2.0

# General System Config
CONFIG_MAIN_STACK_SIZE=2048
CONFIG_SYSTEM_WORKQUEUE_STACK_SIZE=2048

# Console
CONFIG_CONSOLE=y
CONFIG_SERIAL=y
CONFIG_UART_CONSOLE=y

# GPIO
CONFIG_GPIO=y

# Clock Control (verify who/what needs this)
CONFIG_CLOCK_CONTROL=y

# Haptic Motor
CONFIG_HAPTICS=y

# Power
CONFIG_REGULATOR=y

# Display LCD Panel
CONFIG_DISPLAY=y
CONFIG_ST7789V_BGR565=y

# Display Touch Panel
CONFIG_INPUT=y
CONFIG_INPUT_FT5336_INTERRUPT=y

# Display LED Backlight
CONFIG_PWM=y

# IMU
CONFIG_SENSOR=y
CONFIG_SENSOR_ASYNC_API=y
CONFIG_BMA4XX_BOOT_RESET_HACK=y
CONFIG_BMA4XX_DECODER_PATCH_HACK=y

# Real Time Clock
CONFIG_RTC=y

# LoRa & LoRaWAN
CONFIG_LORA=y
CONFIG_LORAWAN=y

# Flash Storage
CONFIG_FLASH=y

# WiFi
CONFIG_NETWORKING=y
CONFIG_NET_L2_ETHERNET=y
CONFIG_WIFI=y
CONFIG_NET_MGMT=y
CONFIG_NET_MGMT_EVENT=y
CONFIG_NET_MGMT_EVENT_INFO=y
CONFIG_NET_L2_WIFI_MGMT=y
```

## drivers/axp2101/Kconfig
```kconfig
config AXP2101_INIT_PRIORITY
	int "AXP2101 driver initialization priority"
	depends on AXP2101
	default 85
	help
	  Init priority for the AXP2101 driver.

config REGULATOR_AXP2101_INIT_PRIORITY
    int "AXP2101 regulator driver initialization priority"
    depends on REGULATOR_AXP2101
    default 86
    help
      Init priority for the AXP2101 regulator driver.

config GPIO_AXP2101_INIT_PRIORITY
    int "AXP2101 GPIO driver initialization priority"
    depends on GPIO_AXP2101
    default 86
    help
      Init priority for the AXP2101 GPIO driver.

config CHARGER_AXP2101_INIT_PRIORITY
    int "AXP2101 charger driver initialization priority"
    depends on CHARGER_AXP2101
    default 86
    help
      Init priority for the AXP2101 charger driver.

config FUEL_GAUGE_AXP2101_INIT_PRIORITY
    int "AXP2101 fuel gauge driver initialization priority"
    depends on FUEL_GAUGE_AXP2101
    default 86
    help
      Init priority for the AXP2101 fuel gauge driver.

if AXP2101
module = AXP2101
module-str = AXP2101
source "subsys/logging/Kconfig.template.log_config"
endif

rsource "Kconfig.axp2101"
```

## drivers/axp2101/Kconfig.axp2101
```kconfig
config AXP2101
	bool "AXP2101 PMIC device driver"
	default y
	depends on DT_HAS_X_POWERS_AXP2101_ENABLED
	select I2C
	help
	  Enable the X-Powers AXP2101 PMIC multi-function device driver
	
config REGULATOR_AXP2101
    bool "X-Powers AXP2101 PMIC regulator driver"
    default y
    depends on AXP2101
	depends on DT_HAS_X_POWERS_AXP2101_REGULATOR_ENABLED
	select REGULATOR
    help
      Enable the AXP2101 PMIC regulator driver

config GPIO_AXP2101
	bool "AXP2101 PMIC GPIO driver"
	default y
	depends on AXP2101
	depends on DT_HAS_X_POWERS_AXP2101_GPIO_ENABLED
	select GPIO

config CHARGER_AXP2101
	bool "AXP2101 PMIC charger driver"
	default y
	depends on AXP2101
	depends on DT_HAS_X_POWERS_AXP2101_CHARGER_ENABLED
	select CHARGER
```

## drivers/bma4xx/Kconfig
```kconfig
config BMA4XX_BOOT_RESET_HACK
	bool "Reset the BMA4XX on boot"
	depends on DT_HAS_BOSCH_BMA4XX_ENABLED
	help
		Reset the BMA423 on boot (works around a bug in the driver).


config BMA4XX_BOOT_RESET_HACK_PRIORITY
	int "Boot reset priority"
	default 55
	depends on BMA4XX_BOOT_RESET_HACK
	help
		Priority for the boot reset.

config BMA4XX_DECODER_PATCH_HACK
	bool "Patch the BMA4XX decoder"
	depends on DT_HAS_BOSCH_BMA4XX_ENABLED
	help
		Patch the BMA4XX decoder to work around a conversion bug
		where a 12-bit integer is incorrectly treated as a 16-bit.
```

## drivers/rmt/Kconfig
```kconfig
config RMT
    bool "Remote Control Tranceiver Driver"

config RMT_INIT_PRIORITY
    int "RMT initialization priority"
    default KERNEL_INIT_PRIORITY_DEVICE

rsource "Kconfig.esp32"

backend = RMT
backend-str = rmt
source "subsys/logging/Kconfig.template.log_format_config"
```

## drivers/rmt/Kconfig.esp32
```kconfig
config RMT_ESP32
    bool "ESP32 RMT driver"
    default y
    depends on DT_HAS_ESPRESSIF_ESP32_RMT_ENABLED
    depends on RMT
```

## drivers/rmt_tx/Kconfig
```kconfig
config RMT_TX
    bool "Remote Control Transmitter Driver"

config RMT_TX_INIT_PRIORITY
    int "RMT TX initialization priority"
    default KERNEL_INIT_PRIORITY_DEVICE

rsource "Kconfig.esp32"

if RMT_TX
module = RMT_TX
module-str = rmt_tx
source "subsys/logging/Kconfig.template.log_config"
endif
```

## drivers/rmt_tx/Kconfig.esp32
```kconfig
config RMT_TX_ESP32
    bool "ESP32 RMT TX driver"
    default y
    depends on DT_HAS_ESPRESSIF_ESP32_RMT_TX_ENABLED
    depends on RMT_TX

config RMT_TX_CHANNEL_INIT_PRIORITY
    int "RMT TX channel initialization priority"
    default 80
    depends on RMT_TX
```

## dts/bindings/axp2101/x-powers,axp2101-charger.yaml
```yaml
# Copyright (c), 2025 Noah Luskey <noah@vvvvvvvvvv.io>

description: X-Powers AXP2101 battery charger

include: battery.yaml

compatible: "x-powers,axp2101-charger"

properties:
  device-chemistry:
    required: true
    const: "lithium-ion"
  precharge-current-microamp:
    required: true
  charge-term-current-microamp:
    required: true
  constant-charge-current-max-microamp:
    required: true
  constant-charge-voltage-max-microvolt:
    required: true
```

## dts/bindings/axp2101/x-powers,axp2101-fuel-gauge.yaml
```yaml
# Copyright (c) 2025 Noah Luskey <noah@vvvvvvvvvv.io>
# SPDX -License-Identifier: Apache-2.0

description: |
  AXP2101 Fuel Gauge

compatible: "x-powers,axp2101-fuel-gauge"

include: [base.yaml, fuel-gauge.yaml]
```

## dts/bindings/axp2101/x-powers,axp2101-gpio.yaml
```yaml
description: |
  AXP2101 Poweron GPIO Access

  The AXP2101 has a poweron input that can be used essentially
  as one additional GPIO input. This binding allows declaration
  of a GPIO 'port' device that can be used to access this input.

compatible: "x-powers,axp2101-gpio"

include: [gpio-controller.yaml, base.yaml]

properties:
  "#gpio-cells":
    const: 2
  
  ngpios:
    const: 1
  
  initial-state-high:
    description: |
      Because the state of the poweron pin can only be known on
      transitions, the initial state is unknown. This can result
      in the first button event being missed. This property allows
      the initial state to be set to a known value.
    type: boolean

gpio-cells:
  - pin
  - flags
  
  
```

## dts/bindings/axp2101/x-powers,axp2101-regulator.yaml
```yaml
# Copyright (c) 2025 Noah Luskey <noah@vvvvvvvvvv.io>
# SPDX -License-Identifier: Apache-2.0

description: |
  AXP2101 PMIC

  The PMIC has three DCDC converters and two LDOs (LDO1 cannot be disabled).
  All need to be defined as children nodes.
  For example:

  i2c {
    pmic@34 {
      reg = <0x34>;
      ...
      regulators {
        compatible = "x-powers,axp2101-regulator";

        DCDC1 {
          /* all properties for DCDC1 */
        };
        DCDC2 {
          /* all properties for DCDC2 */
        };
        DCDC3 {
          /* all properties for DCDC3 */
        };
        LDOIO0 {
          /* all properties for LDOIO0 */
        };
        LDO2 {
          /* all properties for LDO2 */
        };
        LDO3 {
          /* all properties for LDO3 */
        };
      };
    };
  };

compatible: "x-powers,axp2101-regulator"

include: base.yaml

child-binding:
  include:
    - name: regulator.yaml
      property-allowlist:
        - regulator-init-microvolt
        - regulator-min-microvolt
        - regulator-max-microvolt
        - regulator-always-on
        - regulator-boot-on
        - regulator-initial-mode
        - regulator-allowed-modes

  properties:
    regulator-initial-mode:
      type: int
      default: 0
      enum:
        - 0
        - 1
      description: |
        Initial operating mode. AXP2101 supports 2 different power modes:
        AXP2101_DCDC_MODE_AUTO: Auto (0, default)
        AXP2101_DCDC_MODE_PWM: PWM
```

## dts/bindings/axp2101/x-powers,axp2101.yaml
```yaml
description: X-Powers AXP2101

compatible: "x-powers,axp2101"
  
include: i2c-device.yaml

properties:
  reg:
    required: true

  button-battery-charge-enable:
    type: boolean

  int-gpios:
    type: phandle-array
    required: true
    description: |
      GPIO connected to the IRQ pin of the AXP2101
  
  short-press-code:
    type: int
    required: false
    description: |
      Key code to report for short press of the power button
      
  long-press-code:
    type: int
    required: false
    description: |
      Key code to report for long press of the power button
  
```

## dts/bindings/rmt/espressif,esp32-rmt-tx.yaml
```yaml
description: ESP32 Remote Control Tranceiver

compatible: "espressif,esp32-rmt-tx"

include: [base.yaml, pinctrl-device.yaml]

properties:
  reg:
    required: true
  "#address-cells":
    type: int
    const: 1
  "#size-cells":
    type: int
    const: 0
  interrupts:
    required: true
  interrupt-parent:
    required: true

child-binding:
  description: Channel configuration
  properties:
    reg:
      type: int
      required: true
      enum:
        - 0
        - 1
        - 2
        - 3
  
    gpios:
      type: phandle-array
      required: true
      description: |
        GPIO pin used to transmit the signal
    
    invert-out:
      type: boolean
      description: |
        Invert the output signal
  
```

## dts/bindings/rmt/espressif,esp32-rmt.yaml
```yaml
description: ESP32 Remote Control Tranceiver

compatible: "espressif,esp32-rmt-tx"

include: base.yaml
```

## tests/testcase.yaml
```yaml
tests:
  t-watch-s3.bringup:
    platform_allow:
      - t_watch_s3/esp32s3/procpu
    extra_configs:
      - CONFIG_RUNNING_UNDER_CI=y
```

## west.yml
```yaml
manifest:
  defaults:
    remote: zephyrproject-rtos

  remotes:
    - name: zephyrproject-rtos
      url-base: https://github.com/zephyrproject-rtos
  
  projects:
    - name: zephyr
      remote: zephyrproject-rtos
      import: true
      repo-path: zephyr
      revision: v4.1.0

  self:
    path: t-watch-s3
```
